#include <reg52.h>
 
/*----------------音乐函数申明------------------------------*/
void Play();
void InitialSound(unsigned char *Sound0,unsigned char sw3,
    unsigned char Octachord0,unsigned int Speed0);
/*----------------音乐数据申明------------------------------*/
extern unsigned char code Music_Croatian_Rhapsody[];
//数据太大，放后面了，所以加extern以说明
//void delay10ms(void)   //误差 0us
//{
//    unsigned char a,b,c;
//    for(c=1;c>0;c--)
//        for(b=38;b>0;b--)
//            for(a=130;a>0;a--);
//}
void main()
{
    unsigned int cnt = 0;
    InitialSound(Music_Croatian_Rhapsody,0,2,360);  //蜂鸣器初始化
     
    while(1)
    {
     	Play();                                 //蜂鸣器
    }
}
 
 
 
/*-----------------------以下是蜂鸣器演奏------------------*/
#define SYSTEM_OSC      12000000    //12000000 11059200 //定义晶振频率12000000HZ
#define SOUND_SPACE     4/5         //定义普通音符演奏的长度分率,//每4分音符间隔
sbit    BeepIO    =     P1^0;       //定义输出管脚
 
unsigned int  code FreTab[12]  = { 262,277,294,311,330,349,369,392,415,440,466,494 }; //原始频率表
unsigned char code SignTab[7]  = { 0,2,4,5,7,9,11 };                                  //1~7在频率表中的位置
unsigned char code LengthTab[7]= { 1,2,4,8,16,32,64 };                      
unsigned char Sound_Temp_TH0,Sound_Temp_TL0;    //音符定时器初值暂存 
unsigned char Sound_Temp_TH1,Sound_Temp_TL1;    //音长定时器初值暂存
unsigned char Signature;
unsigned char Octachord;
unsigned int Speed;
unsigned char *Sound;
unsigned int NewFreTab[12];                     //新的频率表
unsigned char i,j;
unsigned int Point,LDiv,LDiv0,LDiv1,LDiv2,LDiv4,CurrentFre,Temp_T,SoundLength;
unsigned char Tone,Length,SL,SH,SM,SLen,XG,FD;
 
void InitialSound(unsigned char *Sound0,unsigned char Signature0,unsigned char Octachord0,unsigned int Speed0)
{
        Signature = Signature0;
    Octachord = Octachord0;
    Speed = Speed0;
    Sound = Sound0;
    
    for(i=0;i<12;i++)               // 根据调号及升降八度来生成新的频率表 
    {
        j = i + Signature;
        if(j > 11)
        {
            j = j-12;
            NewFreTab[i] = FreTab[j]*2;
        }
        else
            NewFreTab[i] = FreTab[j];

        if(Octachord == 1)
            NewFreTab[i]>>=2;
        else if(Octachord == 3)
            NewFreTab[i]<<=2;
    }                                   
    
    SoundLength = 1;
    while(Sound[SoundLength] != 0x00)   //计算歌曲长度
    {
        SoundLength+=2;
    }

    Point = 0;
    Tone   = Sound[Point];  
    Length = Sound[Point+1];            // 读出第一个音符和它时时值
    
    LDiv0 = 12000/Speed;                // 算出1分音符的长度(几个10ms)    
    LDiv4 = LDiv0/4;                    // 算出4分音符的长度 
    LDiv4 = LDiv4-LDiv4*SOUND_SPACE;    // 普通音最长间隔标准 
    
    BeepIO = 1;
    Sound_Temp_TH1 = (65535-(1/1200)*SYSTEM_OSC)/256;   // 计算TL1应装入的初值  (10ms的初装值)
    Sound_Temp_TL1 = (65535-(1/1200)*SYSTEM_OSC)%256;   // 计算TH1应装入的初值 
    TH1 = Sound_Temp_TH1;
    TL1 = Sound_Temp_TL1;
    TMOD  |= 0x11;
    ET0    = 1;
    ET1    = 0;
    TR0    = 0;
    TR1    = 0;
    EA     = 1;
}
 
void BeepTimer0(void) interrupt 1   //音符发生中断
{
    BeepIO = !BeepIO;
    TH0    = Sound_Temp_TH0;
    TL0    = Sound_Temp_TL0;
}
 
void Play()
{
    EA = 1;
    TR0   = 0;
    TR1   = 1;
    if(Point < SoundLength)
    {
        SL=Tone%10;                                 //计算出音符 
        SM=Tone/10%10;                              //计算出高低音 
        SH=Tone/100;                                //计算出是否升半 
        CurrentFre = NewFreTab[SignTab[SL-1]+SH];   //查出对应音符的频率     
        if(SL!=0)
        {
            if (SM==1) CurrentFre >>= 2;        //低音 
            if (SM==3) CurrentFre <<= 2;        //高音
            Temp_T = 65536-(50000/CurrentFre)*10/(12000000/SYSTEM_OSC);//计算计数器初值
            Sound_Temp_TH0 = Temp_T/256; 
            Sound_Temp_TL0 = Temp_T%256; 
            TH0 = Sound_Temp_TH0;  
            TL0 = Sound_Temp_TL0 + 12; //加12是对中断延时的补偿 
        }
        SLen=LengthTab[Length%10];  //算出是几分音符
        XG=Length/10%10;            //算出音符类型(0普通1连音2顿音) 
        FD=Length/100;
        LDiv=LDiv0/SLen;            //算出连音音符演奏的长度(多少个10ms)
        if (FD==1) 
        {
            LDiv=LDiv+LDiv/2;
        }
        
        if(XG!=1)
        {           
            if(XG==0)               //算出普通音符的演奏长度 
            {
                if (SLen<=4)    
                {
                    LDiv1=LDiv-LDiv4;
                }else{
                    LDiv1=LDiv*SOUND_SPACE;
                }
            }else{
                LDiv1=LDiv/2;       //算出顿音的演奏长度 
            }
        }else{
            LDiv1=LDiv;
        }
        
        if(SL==0) 
        {
            LDiv1=0;
        }
        
        LDiv2=LDiv-LDiv1;       //算出不发音的长度 
        
        if (SL!=0)
        {
            TR0=1;
            for(i=LDiv1;i>0;i--)    //发规定长度的音 
            {
                while(TF1==0);      //等待节拍过去
                TH1 = Sound_Temp_TH1;//重装初值
                TL1 = Sound_Temp_TL1;
                TF1=0;              //清除中断标志位
            }
        }
        
        if(LDiv2!=0)
        {
            TR0=0; BeepIO=1;
            for(i=LDiv2;i>0;i--)    //音符间的间隔
            {
                while(TF1==0);      //等待节拍过去
                TH1 = Sound_Temp_TH1;//重装初值
                TL1 = Sound_Temp_TL1;
                TF1=0;              //清除中断标志位
            }
        }
        
        Point+=2; 
        Tone=Sound[Point];
        Length=Sound[Point+1];
        
    }
    else
    {
        /*SoundLength = len;
        Point = poi;*/
        InitialSound(Music_Croatian_Rhapsody,0,2,360);
    }
    BeepIO = 1;
    
    TR0   = 0;
    TR1   = 0;
}
 
//这里放生成的音乐数据
unsigned char code Music_Croatian_Rhapsody[]={
    0x1B,0x04, 0x1F,0x04, 0x1A,0x17, 0x17,0x04, 0x18,0x04,
    0x16,0x7B, 0x18,0x68, 0x19,0x04, 0x17,0x03, 0x17,0x03,
    0x11,0x04, 0x15,0x04, 0x10,0x03, 0x11,0x04, 0x15,0x04,
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    0x1B,0x03, 0x17,0x03, 0x1A,0x03, 0x1A,0x02, 0x00,0x00
};
